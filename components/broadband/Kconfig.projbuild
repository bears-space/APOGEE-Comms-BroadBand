## components/broadband/Kconfig.projbuild
```kconfig
menu "APOGEE Comms Broadband Component"
    choice BB_COMM_TYPE
        prompt "Communication Type"
        default BB_COMM_TYPE_TX
        help
            Select the type of communication functionality to enable in Broadband Component.

        config BB_COMM_TYPE_TX
            bool "Transmitter Mode"
            help
                Enable Transmitter Mode functionality in Broadband Component.
        
        config BB_COMM_TYPE_RX
            bool "Receiver Mode"
            help
                Enable Receiver Mode functionality in Broadband Component.
    endchoice

    config BB_CHANNEL
        int "Broadband Wi-Fi Channel"
        default 6
        range 1 11
        help
            Set the Wi-Fi channel for broadband communication. Valid range is 1 to 11.

    config BB_MAX_PAYLOAD
        int "Maximum Payload Size"
        default 512
        range 1 2048
        help
            Set the maximum payload size for broadband communication in bytes. Valid range is 1 to 2048.

    config BB_PROTOCOL_VER
        int "Protocol Version"
        default 1
        range 1 10
        help
            Set the protocol version for broadband communication. Valid range is 1 to 10.

            
    if BB_COMM_TYPE_TX
        choice BB_WIFI_MODE
            prompt "Wi-Fi PHY Rate"
            default BB_WIFI_PHY_RATE_6M
            help
                Select the PHY rate used by esp_wifi_80211_tx() for broadband
                transmission. This controls the modulation, coding rate, and
                nominal physical-layer data rate of transmitted packets.

            config BB_WIFI_PHY_RATE_1M_L
                bool "DSSS + DBPSK, 1 Mbps (802.11b, long preamble)"
                help
                    Use the legacy 802.11b DSSS PHY with DBPSK modulation
                    and a long preamble at 1 Mbps.

            config BB_WIFI_PHY_RATE_2M_L
                bool "DSSS + DQPSK, 2 Mbps (802.11b, long preamble)"
                help
                    Use the legacy 802.11b DSSS PHY with DQPSK modulation
                    and a long preamble at 2 Mbps.

            config BB_WIFI_PHY_RATE_6M
                bool "OFDM + BPSK 1/2, 6 Mbps (802.11g)"
                help
                    Use the legacy 802.11g OFDM PHY with BPSK modulation
                    and a 1/2 coding rate at 6 Mbps.

            config BB_WIFI_PHY_RATE_12M
                bool "OFDM + QPSK 1/2, 12 Mbps (802.11g)"
                help
                    Use the legacy 802.11g OFDM PHY with QPSK modulation
                    and a 1/2 coding rate at 12 Mbps.

            config BB_WIFI_PHY_RATE_24M
                bool "OFDM + 16-QAM 1/2, 24 Mbps (802.11g)"
                help
                    Use the legacy 802.11g OFDM PHY with 16-QAM modulation
                    and a 1/2 coding rate at 24 Mbps.

            config BB_WIFI_PHY_RATE_48M
                bool "OFDM + 64-QAM 2/3, 48 Mbps (802.11g)"
                help
                    Use the legacy 802.11g OFDM PHY with 64-QAM modulation
                    and a 2/3 coding rate at 48 Mbps.

            config BB_WIFI_PHY_RATE_MCS0_LGI
                bool "HT-OFDM + BPSK 1/2, MCS0 long GI (802.11n)"
                help
                    Use the 802.11n HT PHY with BPSK modulation, a 1/2 coding
                    rate, and a long guard interval. With a 20 MHz channel,
                    MCS0 provides a nominal PHY rate of 6.5 Mbps.

        endchoice
    endif
    config BB_BSSID
        string "Broadband BSSID"
        default "02:42:42:42:42:42"
        help
            Set the BSSID for broadband communication. Format should be a valid MAC address. Not an actual access point, but used for identification in the protocol.
    config BB_BROADCAST_MAC
        string "Broadband Broadcast MAC"
        default "FF:FF:FF:FF:FF:FF"
        help
            Set the broadcast MAC address for broadband communication. Format should be a valid MAC address. Used for broadcasting messages in the protocol.        
endmenu
```
